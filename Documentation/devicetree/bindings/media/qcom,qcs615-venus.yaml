## Documentation/devicetree/bindings/media/qcom,qcs615-venus.yaml
```yaml
# SPDX-License-Identifier: (GPL-2.0 OR BSD-2-Clause)
%YAML 1.2
---
$id: http://devicetree.org/schemas/media/qcom,qcs615-venus.yaml#
$schema: http://devicetree.org/meta-schemas/core.yaml#

title: Qualcomm QCS615 Venus video encode and decode accelerators

maintainers:
  - Stanimir Varbanov <stanimir.k.varbanov@gmail.com>
  - Vikash Garodia <quic_vgarodia@quicinc.com>

description:
  The Venus IP is a video encode and decode accelerator present
  on Qualcomm platforms

allOf:
  - $ref: qcom,venus-common.yaml#

properties:
  compatible:
    const: qcom,qcs615-venus

  power-domains:
    minItems: 2
    maxItems: 3

  power-domain-names:
    minItems: 2
    items:
      - const: venus
      - const: vcodec0
      - const: cx

  clocks:
    maxItems: 5

  clock-names:
    items:
      - const: core
      - const: iface
      - const: bus
      - const: vcodec0_core
      - const: vcodec0_bus

  iommus:
    maxItems: 1

  memory-region:
    maxItems: 1

  interconnects:
    maxItems: 2

  interconnect-names:
    items:
      - const: video-mem
      - const: cpu-cfg

  operating-points-v2: true

  opp-table:
    type: object

  video-decoder:
    type: object

    additionalProperties: false

    properties:
      compatible:
        const: venus-decoder

    required:
      - compatible

  video-encoder:
    type: object

    additionalProperties: false

    properties:
      compatible:
        const: venus-encoder

    required:
      - compatible

required:
  - compatible
  - power-domain-names
  - iommus
  - video-decoder
  - video-encoder

unevaluatedProperties: false

examples:
  - |
    #include <dt-bindings/interrupt-controller/arm-gic.h>
    #include <dt-bindings/clock/qcom,qcs615-videocc.h>
    #include <dt-bindings/interconnect/qcom,qcs615-rpmh.h>
    #include <dt-bindings/power/qcom,rpmhpd.h>

    venus: video-codec@aa00000 {
        compatible = "qcom,qcs615-venus";
        reg = <0xaa00000 0x100000>;
        interrupts = <GIC_SPI 174 IRQ_TYPE_LEVEL_HIGH>;

        clocks = <&videocc VIDEO_CC_VENUS_CTL_CORE_CLK>,
                 <&videocc VIDEO_CC_VENUS_AHB_CLK>,
                 <&videocc VIDEO_CC_VENUS_CTL_AXI_CLK>,
                 <&videocc VIDEO_CC_VCODEC0_CORE_CLK>,
                 <&videocc VIDEO_CC_VCODEC0_AXI_CLK>;
        clock-names = "core",
                      "iface",
                      "bus",
                      "vcodec0_core",
                      "vcodec0_bus";

        power-domains = <&videocc VENUS_GDSC>,
                        <&videocc VCODEC0_GDSC>,
                        <&rpmhpd RPMHPD_CX>;
        power-domain-names = "venus",
                             "vcodec0",
                             "cx";

        operating-points-v2 = <&venus_opp_table>;

        interconnects = <&mmss_noc MASTER_VIDEO_P0 0
                         &mc_virt SLAVE_EBI1 0>,
                        <&gem_noc MASTER_APPSS_PROC 0
                         &config_noc SLAVE_VENUS_CFG 0>;
        interconnect-names = "video-mem",
                             "cpu-cfg";

        iommus = <&apps_smmu 0xe40 0x20>;

        memory-region = <&pil_video_mem>;

        video-decoder {
            compatible = "venus-decoder";
        };

        video-encoder {
            compatible = "venus-encoder";
        };

        venus_opp_table: opp-table {
            compatible = "operating-points-v2";

            opp-133330000 {
                opp-hz = /bits/ 64 <133330000>;
                required-opps = <&rpmhpd_opp_low_svs>;
            };

            opp-240000000 {
                opp-hz = /bits/ 64 <240000000>;
                required-opps = <&rpmhpd_opp_svs>;
            };

            opp-300000000 {
                opp-hz = /bits/ 64 <300000000>;
                required-opps = <&rpmhpd_opp_svs_l1>;
            };

            opp-380000000 {
                opp-hz = /bits/ 64 <380000000>;
                required-opps = <&rpmhpd_opp_nom>;
            };

            opp-410000000 {
                opp-hz = /bits/ 64 <410000000>;
                required-opps = <&rpmhpd_opp_turbo>;
            };

            opp-460000000 {
                opp-hz = /bits/ 64 <460000000>;
                required-opps = <&rpmhpd_opp_turbo_l1>;
            };
        };
    };
```

## drivers/char/broadcom/Kconfig
```kconfig
#
# Broadcom char driver config
#

menuconfig BRCM_CHAR_DRIVERS
	bool "Broadcom Char Drivers"
	help
	  Broadcom's char drivers

if BRCM_CHAR_DRIVERS

config BCM_VCIO
	tristate "Mailbox userspace access"
	depends on BCM2835_MBOX
	help
	  Gives access to the mailbox property channel from userspace.

endif
```

## drivers/firmware/qcom/Kconfig
```kconfig
# SPDX-License-Identifier: GPL-2.0-only
#
# For a description of the syntax of this configuration file,
# see Documentation/kbuild/kconfig-language.rst.
#

menu "Qualcomm firmware drivers"

config QCOM_TZMEM
	tristate "QCOM_TZMEM"
	select GENERIC_ALLOCATOR

choice
	prompt "TrustZone interface memory allocator mode"
	depends on QCOM_TZMEM
	default QCOM_TZMEM_MODE_GENERIC
	help
	  Selects the mode of the memory allocator providing memory buffers of
	  suitable format for sharing with the TrustZone. If in doubt, select
	  'Generic'.

config QCOM_TZMEM_MODE_GENERIC
	bool "Generic"
	help
	  Use the generic allocator mode. The memory is page-aligned, non-cachable
	  and physically contiguous.

config QCOM_TZMEM_MODE_SHMBRIDGE
	bool "SHM Bridge"
	help
	  Use Qualcomm Shared Memory Bridge. The memory has the same alignment as
	  in the 'Generic' allocator but is also explicitly marked as an SHM Bridge
	  buffer.

	  With this selected, all buffers passed to the TrustZone must be allocated
	  using the TZMem allocator or else the TrustZone will refuse to use them.

endchoice

endmenu
```

## kernel/kernel-noble/drivers/staging/nv-pci/Kconfig
```kconfig
menuconfig NVIDIA_PCIE_TEGRA264_ST
	bool "NVIDIA PCIe Tegra 264 external driver"
	depends on PCI
	select PCIE_TEGRA264
	select PCIE_TEGRA264_EP
	select PCIE_TEGRA194_EP
	help
	  Enable support for NVIDIA PCIe Tegra264 driver built-in in the kernel.

config PCIE_TEGRA264
	tristate "PCIE_TEGRA264"

config PCIE_TEGRA264_EP
	tristate "PCIE_TEGRA264_EP"
```
